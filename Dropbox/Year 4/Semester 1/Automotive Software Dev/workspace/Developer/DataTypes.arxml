AUTOSAR XML (schema 4-2-1)
standard types defined: boolean, uint16, uint32, uint8, float32_DataConstr, float64_DataConstr, sint16_DataConstr, sint32_DataConstr, sint8_DataConstr, uint16_DataConstr, uint32_DataConstr, uint8_DataConstr, float32, float64, sint16, sint32, sint8
package /ComponentTypes/DataTypeMappingSets
  data type mapping set DemoTypeMapping
    data-type-maps:
      application-data-type=AdtDoorState, implementation-data-type=IdtDoorState
      application-data-type=AdtLightDimCtrl, implementation-data-type=uint16
      application-data-type=AdtLightState, implementation-data-type=uint8
    mode-request-type-maps:
      implementation-data-type=BswM_ESH_Mode, mode-group=ESH_Mode
      implementation-data-type=ComM_ModeType, mode-group=ComMMode
      implementation-data-type=Dcm_CommunicationModeType, mode-group=DcmCommunicationControl
      implementation-data-type=Dcm_ControlDtcSettingType, mode-group=DcmControlDtcSetting
      implementation-data-type=Dcm_DiagnosticSessionControlType, mode-group=DcmDiagnosticSessionControl
      implementation-data-type=Dcm_EcuResetType, mode-group=DcmEcuReset
      implementation-data-type=WdgMMode, mode-group=WdgM_Mode
  data type mapping set DemoTypeMappingCtSaDoor
package /DataType
  4 x base type, all with category=FIXED_LENGTH, base-type-encoding=ISO-8859-1:
    uint8_4_iso_8859_1: base-type-size=32
    uint8_5_iso_8859_1: base-type-size=40
    uint8_6_iso_8859_1: base-type-size=48
    uint8_7_iso_8859_1: base-type-size=56
package /DataType/Semantics
  compu method CM_New_Coding_5: phys=raw for raw >0..<255
  compu method CM_New_Coding_6: phys=raw for raw >0..<255
  compu method CM_NmUd_MyECU_16bit: phys=raw for raw 0..65535
  compu method CM_NmUd_MyECU_32bit: phys=raw for raw 0..4294967295
  compu method CM_Sig_ErrBit_RearECU: phys=raw for raw 0..1
  compu method CM_Sig_ErrBit_Slave3: phys=raw for raw 0..1
  compu method CM_Sig_LinTr_MyECU: phys=raw for raw 0..255
  compu method CM_Sig_LinTr_MyECU2_0: phys=raw for raw 0..63
  compu method CM_Sig_LinTr_MyECU2_1: phys=raw for raw 0..16383
  compu method CM_Sig_LinTr_RearECU: phys=raw for raw 0..127
  compu method CM_Sig_LinTr_Slave3_0: phys=raw for raw 0..15
  compu method CM_Sig_LinTr_Slave3_1: phys=raw for raw 0..4095
  compu method CM_Signal_RearInteriorLight: phys=raw for raw 0..1
  compu method CM_Signal_RearLeftDoor: phys=raw for raw 0..1
  compu method CM_Signal_RearRightDoor: phys=raw for raw 0..1
  compu method CM_Signal_Rx11bit_OnWrite: phys=raw for raw 0..2047
  compu method CM_Signal_Rx15bit_OnWrite: phys=raw for raw 0..32767
  compu method CM_Signal_Rx16bit_Cyclic: phys=raw for raw 0..65535
  compu method CM_Signal_Rx20bit_Cyclic: phys=raw for raw 0..1048575
  compu method CM_Signal_Rx8bit_Cyclic: phys=raw for raw 0..255
  compu method CM_Signal_RxMulti0_0: phys=raw for raw 0..7
  compu method CM_Signal_RxMulti0_1: phys=raw for raw 0..65535
  compu method CM_Signal_RxMulti0_2: phys=raw for raw 0..1
  compu method CM_Signal_RxMulti1_0: phys=raw for raw 0..15
  compu method CM_Signal_RxMulti1_1: phys=raw for raw 0..4095
  compu method CM_Signal_RxMulti1_2: phys=raw for raw 0..63
  compu method CM_Signal_RxMultiplexor: phys=raw for raw 0..7
  compu method CM_Signal_SwitchRearInteriorLight: phys=raw for raw 0..255
  compu method CM_Signal_Tx10bit_Cyclic: phys=raw for raw 0..1023
  compu method CM_Signal_Tx24bit_Cyclic: phys=raw for raw 0..16777215
  compu method CM_Signal_Tx24bit_OnWrite: phys=raw for raw 0..16777215
  compu method CM_Signal_Tx32bit_Cyclic: phys=raw for raw 0..4294967295
  compu method CM_Signal_Tx32bit_OnWrite: phys=raw for raw 0..4294967295
  compu method CM_Signal_Tx4bit_Cyclic: phys=raw for raw 0..15
  compu method CM_Signal_TxMulti0_0: phys=raw for raw 0..3
  compu method CM_Signal_TxMulti0_1: phys=raw for raw 0..255
  compu method CM_Signal_TxMulti0_2: phys=raw for raw 0..15
  compu method CM_Signal_TxMulti0_3: phys=raw for raw 0..255
  compu method CM_Signal_TxMulti1_{0..4}: phys=raw for raw 0..255
  compu method CM_Signal_TxMultiplexor: phys=raw for raw 0..7
  compu method CM_SigRx_Prof1C_CRC: phys=raw for raw 0..255
  compu method CM_SigRx_Prof1C_DataId_HiByte_LoNib: phys=raw for raw 0..15
  compu method CM_SigRx_Prof1C_DataId_LoByte: phys=raw for raw 0..255
  compu method CM_SigRx_Prof1C_Sig32Bit: phys=raw for raw 0..4294967295
  compu method CM_SigRx_Prof1C_Sig3Bit: phys=raw for raw 0..7
  compu method CM_SigRx_Prof1C_Sig4Bit: phys=raw for raw 0..15
  compu method CM_SigRx_Prof1C_SQ: phys=raw for raw 0..15
  compu method CM_SigTx_Prof1C_CRC: phys=raw for raw 0..255
  compu method CM_SigTx_Prof1C_DataId_HiByte_LoNib: phys=raw for raw 0..15
  compu method CM_SigTx_Prof1C_DataId_LoByte: phys=raw for raw 0..255
  compu method CM_SigTx_Prof1C_Sig16Bit: phys=raw for raw 0..65535
  compu method CM_SigTx_Prof1C_Sig2Bit: phys=raw for raw 0..3
  compu method CM_SigTx_Prof1C_Sig4Bit: phys=raw for raw 0..15
  compu method CM_SigTx_Prof1C_Sig8Bit: phys=raw for raw 0..255
  compu method CM_SigTx_Prof1C_SQ: phys=raw for raw 0..15
package /DataTypes
  app type AdtDoorState: category=VALUE, sw-calibration-access=READ-ONLY
  app type AdtLightDimCtrl: category=VALUE, sw-calibration-access=READ-ONLY
  app type AdtLightState: category=VALUE, sw-calibration-access=READ-ONLY
  6 x impl type, all with type-emitter=RTE:
    IdtDoorState: compu {0=CMDOORSTATE_DOORCLOSED, 1=CMDOORSTATE_DOOROPEN}, implementation-data-type=boolean
    recRx_E2eProt: category=STRUCTURE, sw-calibration-access=READ-ONLY, dynamic-array-size-profile=None
      6 x element, all with category=TYPE_REFERENCE:
        reRx_E2eProt_CRC: implementation-data-type=uint8
        reRx_E2eProt_DataId: range raw 0..15, implementation-data-type=uint4
        reRx_E2eProt_SQ: range raw 0..15, implementation-data-type=uint4
        reRx_E2eProt_3Bit: range raw 0..7, implementation-data-type=uint3
        reRx_E2eProt_4Bit: range raw 0..15, implementation-data-type=uint4
        reRx_E2eProt_32Bit: implementation-data-type=uint32
    recTx_E2eProt: category=STRUCTURE, sw-calibration-access=READ-ONLY, dynamic-array-size-profile=None
      7 x element, all with category=TYPE_REFERENCE:
        reTx_E2eProt_CRC: implementation-data-type=uint8
        reTx_E2eProt_DataId: range raw 0..15, implementation-data-type=uint4
        reTx_E2eProt_SQ: range raw 0..15, implementation-data-type=uint4
        reTx_E2eProt_2Bit: range raw 0..3, implementation-data-type=uint2
        reTx_E2eProt_4Bit: range raw 0..15, implementation-data-type=uint4
        reTx_E2eProt_8Bit: implementation-data-type=uint8
        reTx_E2eProt_16Bit: implementation-data-type=uint16
    uint2: range raw 0..3, implementation-data-type=uint8
    uint3: range raw 0..7, implementation-data-type=uint8
    uint4: range raw 0..15, implementation-data-type=uint8
