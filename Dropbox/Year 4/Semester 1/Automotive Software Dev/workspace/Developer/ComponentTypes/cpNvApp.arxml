AUTOSAR XML (schema 4-0-3)
package /ComponentTypes
  nv block sw component type cpNvApp
    behavior cpNvApp_InternalBehavior
      data received event DRT_NvM_AdcValue_IoHwAb_Get_Adc_Signals_piAdcValue_AdcValue: start-on-event=NvM_AdcValue_IoHwAb_Get_Adc_Signals, data=AdcValue
      runnable NvM_AdcValue_IoHwAb_Get_Adc_Signals
    nv block descriptor NVBlock_AdcValue: nv-block-data-mapping{nv-ram-block-element=RAM_NVBlock_AdcValue, written-read-nv-data=piAdcValue.AdcValue}
      nv block needs NVNeed_NVBlock_AdcValue: n-data-sets=0, reliability=NO-PROTECTION, restore-at-start=true, store-at-shutdown=true
      ram block RAM_NVBlock_AdcValue: type=uint16, init-value=0
  swc implementation cpNvApp_Implementation: behavior=cpNvApp_InternalBehavior
    code-descriptors:
      code Default: artifact-descriptors=autosar-engineering-object={short-label=Default, category=SWSRC}
