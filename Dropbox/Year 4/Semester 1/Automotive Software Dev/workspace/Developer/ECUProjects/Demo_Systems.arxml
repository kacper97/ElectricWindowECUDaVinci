AUTOSAR XML (schema 4-0-3)
package /ECUCompositionType
  composition sw component type ECU_Composition
package /EndToEndProtection
  end to end protection set EndToEndConnections
package /Systems
  system Demo: category=SYSTEM_EXTRACT
    system mapping Demo_MPPNG
    root-software-compositions:
      root sw composition prototype ECU_Composition: software-composition=ECU_Composition
