AUTOSAR XML (schema 4-2-1)
package /Constants
  constant specification CBackLightDimCtrlInit: value-spec=0
  constant specification CDoorClosed: value-spec=0
  constant specification CLightOff: value-spec=0
