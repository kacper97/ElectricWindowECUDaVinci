AUTOSAR XML (schema 4-2-1)
package /PortInterfaces
  client server interface ResetConfirmation
    operation ConfirmReset
      arg state: type=boolean, direction=IN, server-argument-impl-policy=USE-ARGUMENT-TYPE
  nv data interface piAdcValue
    nv-datas:
      data deAdcValue: sw-calibration-access=READ-ONLY, type=uint16
  13 x sender receiver interface:
    pi_RxE2eProtected: invalidation-policy{data-element=sgRx_E2eProt, handle-invalid=DONT-INVALIDATE}
      data sgRx_E2eProt: type=recRx_E2eProt
    pi_RxMulti0_0: invalidation-policy{data-element=deRxMulti0_0, handle-invalid=DONT-INVALIDATE}
      data deRxMulti0_0: type=uint8
    pi_RxMulti0_1: invalidation-policy{data-element=deRxMulti0_1, handle-invalid=DONT-INVALIDATE}
      data deRxMulti0_1: type=uint16
    pi_RxMulti0_2: invalidation-policy{data-element=deRxMulti0_2, handle-invalid=DONT-INVALIDATE}
      data deRxMulti0_2: type=boolean
    pi_TxE2eProtected: invalidation-policy{data-element=sgTx_E2eProt, handle-invalid=DONT-INVALIDATE}
      data sgTx_E2eProt: type=recTx_E2eProt
    pi_TxMulti0_1: invalidation-policy{data-element=deTxMulti0_1, handle-invalid=DONT-INVALIDATE}
      data deTxMulti0_1: type=uint8
    pi_TxMulti0_2: invalidation-policy{data-element=deTxMulti0_2, handle-invalid=DONT-INVALIDATE}
      data deTxMulti0_2: type=uint8
    pi_TxMulti0_3: invalidation-policy{data-element=deTxMulti0_3, handle-invalid=DONT-INVALIDATE}
      data deTxMulti0_3: type=uint8
    PiDoorState: invalidation-policy{data-element=DeDoorState, handle-invalid=DONT-INVALIDATE}
      data DeDoorState: type=IdtDoorState
    piEventSignal_RxUint16_CAN: invalidation-policy{data-element=deEventSignal_RxUint16_CAN, handle-invalid=DONT-INVALIDATE}
      data deEventSignal_RxUint16_CAN: type=uint16
    piEventSignal_RxUint32_FR: invalidation-policy{data-element=deEventSignal_RxUint32_FR, handle-invalid=DONT-INVALIDATE}
      data deEventSignal_RxUint32_FR: type=uint32
    PiLightDimControl: invalidation-policy{data-element=DeLightDimCtrl, handle-invalid=DONT-INVALIDATE}
      data DeLightDimCtrl: type=AdtLightDimCtrl
    PiLightState: invalidation-policy{data-element=DeLightState, handle-invalid=DONT-INVALIDATE}
      data DeLightState: type=AdtLightState
